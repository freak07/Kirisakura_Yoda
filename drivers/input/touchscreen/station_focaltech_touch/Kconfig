## drivers/input/touchscreen/station_focaltech_touch/Kconfig
```kconfig
#
# Focaltech Touchscreen driver configuration
#

config TOUCHSCREEN_FTS_station
        bool "Focaltech Touchscreen"
		depends on I2C
		default m
		help
		  Say Y here if you have Focaltech touch panel.
		  If unsure, say N.

config TOUCHSCREEN_FTS_DIRECTORY
    string "Focaltech ts directory name"
    default "focaltech_touch"
    depends on TOUCHSCREEN_FTS
    
```
